## prj.conf
```kconfig
## Stack Size
### Main Thread (Low default is 1024)
#CONFIG_MAIN_STACK_SIZE=2048
CONFIG_MAIN_STACK_SIZE=4096
#CONFIG_SYSTEM_WORKQUEUE_STACK_SIZE=2048
CONFIG_SYSTEM_WORKQUEUE_STACK_SIZE=4096

## Kernel Features
### Logging
#CONFIG_LOG=y
#CONFIG_LOG_BACKEND_UART=y
#CONFIG_LOG_DEFAULT_LEVEL=2
#CONFIG_LOG_MODE_DEFERRED=y
#CONFIG_LOG_MODE_IMMEDIATE=y
#CONFIG_LOG_PRINTK=y
#CONFIG_TEST_LOGGING_DEFAULTS=y

### Testing
#CONFIG_ZTEST=y
#CONFIG_TEST=y

## C Library
### SDK 1.0.1 has disabled newlib (default picolib)
CONFIG_PICOLIBC=y
#CONFIG_PICOLIBC_USE_TOOLCHAIN=y
#CONFIG_NEWLIB_LIBC=y
#CONFIG_NEWLIB_LIBC_NANO=n
#CONFIG_COMMON_LIBC_MALLOC=y

CONFIG_POSIX_API=y

### C Library Thread-Safety
#### Thread-safe version of asctime()
CONFIG_COMMON_LIBC_ASCTIME_R=y
#### Thread-safe version of ctime()
CONFIG_COMMON_LIBC_CTIME_R=y
#### Thread-Safe General ISO C Library
CONFIG_POSIX_C_LANG_SUPPORT_R=y
#### Thread-Safe File System
CONFIG_POSIX_FILE_SYSTEM_R=y
#### POSIX thread-safe functions
CONFIG_POSIX_THREAD_SAFE_FUNCTIONS=y
#### REGULATOR Thread-safe reference counting
#CONFIG_REGULATOR_THREAD_SAFE_REFCNT=y

## C++ Language
CONFIG_CPP=y
CONFIG_STD_CPP20=y
CONFIG_REQUIRES_FULL_LIBCPP=y
CONFIG_GLIBCXX_LIBCPP=y
#CONFIG_LIBCPP_IMPLEMENTATION=CONFIG_GLIBCXX_LIBCPP

CONFIG_CPP_EXCEPTIONS=y
CONFIG_CPP_RTTI=y

## Threading

CONFIG_TRACING=y
CONFIG_TRACING_USER=y

CONFIG_MULTITHREADING=y
CONFIG_TIMESLICE_PER_THREAD=y
### 1ms time-slice maximum (10ms default)
### 10000 ticks/s -> tick =   100 us
###  1000 ticks/s -> tick =  1000 us =  1ms
CONFIG_SYS_CLOCK_TICKS_PER_SEC=1000
###   500 ticks/s -> tick =  2000 us =  2ms
###   250 ticks/s -> tick =  4000 us =  4ms
###   125 ticks/s -> tick =  8000 us =  8ms
###   100 ticks/s -> tick = 10000 us = 10ms

CONFIG_SCHED_DEADLINE=y
CONFIG_THREAD_MONITOR=y
CONFIG_THREAD_NAME=y

CONFIG_THREAD_LOCAL_STORAGE=y
CONFIG_CURRENT_THREAD_USE_TLS=y

### pthread API support (default, used for C11 threads.h API)
CONFIG_POSIX_THREADS=y

### C11 <threads.h> API support (default)
CONFIG_COMMON_LIBC_THRD=y

CONFIG_POSIX_PRIORITY_SCHEDULING=y

CONFIG_MP_MAX_NUM_CPUS=1

### Required by CONFIG_DYNAMIC_THREAD (Stores thread stack info)
CONFIG_THREAD_STACK_INFO=y

### Support for dynamic threads [EXPERIMENTAL]
CONFIG_DYNAMIC_THREAD=y
#### Support heap-allocated thread objects and stacks
CONFIG_DYNAMIC_THREAD_ALLOC=y
CONFIG_DYNAMIC_THREAD_PREFER_ALLOC=n
CONFIG_DYNAMIC_THREAD_PREFER_POOL=y
#### pthread (Low default is 1024)
#CONFIG_DYNAMIC_THREAD_STACK_SIZE=2048
CONFIG_DYNAMIC_THREAD_STACK_SIZE=4096

CONFIG_DYNAMIC_THREAD_POOL_SIZE=40
CONFIG_POSIX_THREAD_THREADS_MAX=40
CONFIG_MAX_PTHREAD_MUTEX_COUNT=40

## Hardening

### Kernel to initialize stack areas with a known value (0xaa) before they are first use
CONFIG_INIT_STACKS=y

### Zephyr software-only stack overflow detection (works)
CONFIG_STACK_SENTINEL=y

### Required for CONFIG_STACK_CANARIES, non-rng QEMU
#CONFIG_TEST_RANDOM_GENERATOR=y
### GCC compiler-instrumentation (software) stack corruption detection (???)
#CONFIG_STACK_CANARIES=y

#CONFIG_UBSAN=y
CONFIG_STACK_USAGE=y
CONFIG_ASSERT=y
CONFIG_ASSERT_VERBOSE=y
CONFIG_ASSERT_NO_FILE_INFO=n
#CONFIG_ZTEST_ASSERT_VERBOSE=y

## DEBUG

### Flash size setup in the target board definition, e.g. qemu_cortex_m3 has 256 (kB) and `mps2/an385` is 4MiB
#CONFIG_FLASH_SIZE=384

CONFIG_DEBUG=y
#CONFIG_DEBUG_COREDUMP=y
#CONFIG_EXCEPTION_STACK_TRACE=y

### Disabling all optimization `-O0`, works on `mps2/an385` but crashes on `qemu_cortex_m3` (signal halt)
CONFIG_NO_OPTIMIZATIONS=y
### Enabling debug optimization level `-Og` works also on `qemu_cortex_m3`
#CONFIG_DEBUG_OPTIMIZATIONS=y

#CONFIG_PICOLIBC_NO_OPTIMIZATIONS=y

### Enable thread awareness for debugging tools supporting it
CONFIG_DEBUG_THREAD_INFO=y

### Unhandled exception debugging
CONFIG_EXCEPTION_DEBUG=y
```

## src/main.cpp
```c
/*
 * SPDX-License-Identifier: Apache-2.0 OR MPL-2.0 OR MIT
 *
 * If a copy of the Apache-2.0 license was not distributed with this file,
 * You can obtain one at https://www.apache.org/licenses/LICENSE-2.0.
 *
 * If a copy of the MPL-2.0 license was not distributed with this file,
 * You can obtain one at https://mozilla.org/MPL/2.0/.
 *
 * If a copy of the MIT license was not distributed with this file,
 * you can obtain one at https://opensource.org/license/mit/.
 */

#include <pthread.h>

#include <zephyr/kernel.h>

#include <util/miscutils.hpp>

#define STACKSIZE 2000
static K_THREAD_STACK_DEFINE(kthread__stack, STACKSIZE);

static pthread_key_t key;
static uint8_t const tagP = 0x11U;
static uint8_t const tagK = 0x22U;
static uint8_t const tagM = 0x22U;

static void* pthread_entry(void*)
{
    dbg_PRINT("Thread-P: START");

    pthread_t pself = pthread_self();
    if (!pself) {
        src_ABORT();
    }

    uint8_t *val = (uint8_t *)pthread_getspecific(key);
    if (val) {
        src_ABORT();
    }
    if (0 != pthread_setspecific(key, (void *)&tagP)) {
        src_ABORT();
    }
    val = (uint8_t *)pthread_getspecific(key);
    if (!val) {
        src_ABORT();
    }
    if (val != &tagP) {
        src_ABORT();
    }
    if (*val != tagP) {
        src_ABORT();
    }
    dbg_PRINT("Thread-P: END");
    return NULL;
}

static void kthread_entry() {
    dbg_PRINT("Thread-P: START");

    pthread_t pself = pthread_self();
    if (!pself) {
        src_ABORT();
    }

    uint8_t *val = (uint8_t *)pthread_getspecific(key);
    if (val) {
        src_ABORT();
    }
    if (0 != pthread_setspecific(key, (void *)&tagK)) {
        src_ABORT();
    }
    val = (uint8_t *)pthread_getspecific(key);
    if (!val) {
        src_ABORT();
    }
    if (val != &tagK) {
        src_ABORT();
    }
    if (*val != tagK) {
        src_ABORT();
    }
    dbg_PRINT("Thread-K: END");
}

int main()
{
    pthread_t pthread_thread;
    struct k_thread kthread_thread;

    dbg_PRINT("MAIN: START");

    if (0 != pthread_key_create(&key, nullptr)) {
        src_ABORT();
    }
    uint8_t *val = (uint8_t *)pthread_getspecific(key);
    if (val) {
        src_ABORT();
    }
    if (0 != pthread_setspecific(key, (void *)&tagM)) {
        src_ABORT();
    }
    val = (uint8_t *)pthread_getspecific(key);
    if (!val) {
        src_ABORT();
    }
    if (val != &tagM) {
        src_ABORT();
    }
    if (*val != tagM) {
        src_ABORT();
    }
    dbg_PRINT("MAIN: P1");

    {
        if (pthread_create(&pthread_thread, NULL, &pthread_entry, NULL) != 0) {
            src_ABORT();
        }

        k_thread_create(&kthread_thread, kthread__stack, STACKSIZE,
                        (k_thread_entry_t)kthread_entry, NULL, NULL, NULL,
                        K_PRIO_COOP(7), 0, K_NO_WAIT);

        if (pthread_join(pthread_thread, NULL) != 0) {
            src_ABORT();
        }

        if (k_thread_join(&kthread_thread, K_FOREVER) != 0) {
            src_ABORT();
        }
    }
    dbg_PRINT("END");
    return 0;
}
```
