## CMakeLists.txt
```
# SPDX-License-Identifier: Apache-2.0

cmake_minimum_required(VERSION 3.20.0)
find_package(Zephyr REQUIRED HINTS $ENV{ZEPHYR_BASE})
project(cpp_basic)

get_filename_component(TESTS_DIR "${CMAKE_CURRENT_SOURCE_DIR}" DIRECTORY)
get_filename_component(TEMPDIR1 "${TESTS_DIR}" DIRECTORY)
get_filename_component(PROJECT_REPO_ROOT "${TEMPDIR1}" DIRECTORY)
include(${PROJECT_REPO_ROOT}/cmake/ClangdSetup.cmake)
ClangdSetup()

add_compile_options(-g -ggdb -DDEBUG)

# Generate zephyr/heap_constants.h first
# https://docs.zephyrproject.org/latest/releases/migration-guide-4.4.html#kernel
add_dependencies(app zephyr_generated_headers)

FILE(GLOB app_sources src/*.cpp)
zephyr_include_directories(${ZEPHYR_BASE}/subsys/portability/posix)

target_sources(app PRIVATE ${app_sources})

target_compile_options(app PRIVATE -U_POSIX_C_SOURCE -D_POSIX_C_SOURCE=200809L)
target_include_directories(app PRIVATE ${ZEPHYR_BASE}/subsys/portability/posix/options)
```

## prj.conf
```kconfig
CONFIG_POSIX_API=y
CONFIG_POSIX_THREAD_THREADS_MAX=6
CONFIG_ZTEST=y
CONFIG_POSIX_SEM_VALUE_MAX=32767
CONFIG_POSIX_MESSAGE_PASSING=y
CONFIG_POSIX_PRIORITY_SCHEDULING=y
CONFIG_HEAP_MEM_POOL_SIZE=8192
CONFIG_POSIX_THREAD_KEYS_MAX=512
CONFIG_TEST_EXTRA_STACK_SIZE=8192

CONFIG_SYS_HEAP_RUNTIME_STATS=y

## Stack Size
### Main Thread (Low default is 1024)
#CONFIG_MAIN_STACK_SIZE=2048
CONFIG_MAIN_STACK_SIZE=8192
#CONFIG_SYSTEM_WORKQUEUE_STACK_SIZE=2048
CONFIG_SYSTEM_WORKQUEUE_STACK_SIZE=8192

## C++ Language
CONFIG_CPP=y
CONFIG_STD_CPP20=y
CONFIG_REQUIRES_FULL_LIBCPP=y
CONFIG_GLIBCXX_LIBCPP=y

CONFIG_CPP_EXCEPTIONS=y
CONFIG_CPP_RTTI=y

## Threading
CONFIG_MULTITHREADING=y
CONFIG_SCHED_DEADLINE=y
CONFIG_THREAD_MONITOR=y
CONFIG_THREAD_NAME=y
CONFIG_THREAD_LOCAL_STORAGE=y
CONFIG_CURRENT_THREAD_USE_TLS=y

# Thread Safety
#CONFIG_COMMON_LIBC_ASCTIME_R=y
#CONFIG_COMMON_LIBC_CTIME_R=y
CONFIG_POSIX_C_LANG_SUPPORT_R=y
CONFIG_POSIX_FILE_SYSTEM_R=y
CONFIG_POSIX_THREAD_SAFE_FUNCTIONS=y

### pthread API support (default, used for C11 threads.h API)
CONFIG_POSIX_THREADS=y
CONFIG_PTHREAD_CREATE_BARRIER=y

### Required by CONFIG_DYNAMIC_THREAD (Stores thread stack info)
CONFIG_THREAD_STACK_INFO=y

### Support for dynamic threads [EXPERIMENTAL]
CONFIG_DYNAMIC_THREAD=y
#### Support heap-allocated thread objects and stacks
CONFIG_DYNAMIC_THREAD_ALLOC=y
CONFIG_DYNAMIC_THREAD_PREFER_ALLOC=n
CONFIG_DYNAMIC_THREAD_PREFER_POOL=y
#### pthread (Low default is 1024)
#CONFIG_DYNAMIC_THREAD_STACK_SIZE=2048
CONFIG_DYNAMIC_THREAD_STACK_SIZE=8192

CONFIG_DYNAMIC_THREAD_POOL_SIZE=40
CONFIG_POSIX_THREAD_THREADS_MAX=40
CONFIG_MAX_PTHREAD_MUTEX_COUNT=40
CONFIG_MAX_PTHREAD_COND_COUNT=41

## DEBUG

#CONFIG_LOG_DEFAULT_LEVEL=3 (default, INFO)

### Flash size setup in the target board definition, e.g. qemu_cortex_m3 has 256 (kB) and `mps2/an385` is 4MiB
#CONFIG_FLASH_SIZE=384

CONFIG_DEBUG=y
#CONFIG_DEBUG_COREDUMP=y

### Disabling all optimization `-O0`, works on `mps2/an385` but crashes on `qemu_cortex_m3` (signal halt)
CONFIG_NO_OPTIMIZATIONS=y
### Enabling debug optimization level `-Og` works also on `qemu_cortex_m3`
#CONFIG_DEBUG_OPTIMIZATIONS=y

#CONFIG_PICOLIBC_NO_OPTIMIZATIONS=y

### Enable thread awareness for debugging tools supporting it
CONFIG_DEBUG_THREAD_INFO=y

### Unhandled exception debugging
CONFIG_EXCEPTION_DEBUG=y
```

## src/alloc_new.cpp
```c
/*
 * SPDX-License-Identifier: Apache-2.0 OR MPL-2.0 OR MIT
 *
 * If a copy of the Apache-2.0 license was not distributed with this file,
 * You can obtain one at https://www.apache.org/licenses/LICENSE-2.0.
 *
 * If a copy of the MPL-2.0 license was not distributed with this file,
 * You can obtain one at https://mozilla.org/MPL/2.0/.
 *
 * If a copy of the MIT license was not distributed with this file,
 * you can obtain one at https://opensource.org/license/mit/.
 */

#include <zephyr/ztest_assert.h>
#include <zephyr/kernel.h>
#include <zephyr/sys/util.h>
#include <zephyr/ztest.h>
#include <sys_malloc.h>

#include <limits>
#include <vector>
#include <stdexcept>
#include <cstdint>

// #define dbg_PRINT(fmt, ...)
#define dbg_PRINT(fmt, ...)                                                                        \
	{                                                                                          \
		fprintf(stderr, "DBG @ alloc_new:%d %s: ", __LINE__, __func__);                	   \
		fprintf(stderr, (fmt)__VA_OPT__(, ) __VA_ARGS__);                                  \
		fputs("\n", stderr);                                                               \
	}

namespace
{
  /** 2 GB 2'147'483'648 (0x80000000), exceeding max 32-bit platform alloc size by 1. */
  constexpr const size_t two_gb = 2UL * 1024UL * 1024UL * 1024UL;

  /** Max 32-bit platform alloc size `2 GB - 1`, i.e. 2'147'483'647 */
  constexpr const size_t oom_size = std::numeric_limits<int>::max();

  constexpr const size_t small_size = 1024UL; // 1kB
  	
  class Small
  {
    public:
      uint8_t data[small_size];

      Small(void) = default;
  };

  class Big
  {
    public:
      uint8_t data[oom_size];

      Big(void) = default;
  };
}

static struct sys_memory_stats malloc_stats;

typedef void (*alloc_op_t)();

static void test_alloc_OK(alloc_op_t alloc_op)
{
	dbg_PRINT("Start");
	try {
		alloc_op();
	} catch (std::exception const &e) {
		dbg_PRINT("exception caught: %s", e.what());
		zassert_unreachable();
	}
	dbg_PRINT("End");
}

static void test_alloc_OOM(bool shall_throw_bad_alloc, alloc_op_t alloc_op)
{
	dbg_PRINT("Start");
	try {
		alloc_op();
	} catch (std::bad_alloc const &oom) {
		if (shall_throw_bad_alloc) {
			dbg_PRINT("expected exception caught: %s", oom.what());
		} else {
			dbg_PRINT("unexpected exception caught: %s", oom.what());
			zassert_unreachable();
		}
	} catch (std::exception const &e) {
		dbg_PRINT("unexpected exception caught: %s", e.what());
		zassert_unreachable();
	}
	dbg_PRINT("End");
}

ZTEST(cpp_basic_alloc_new, test_calloc_chunk_OK)
{
	test_alloc_OK([](){
		uint8_t* mem = (uint8_t*)std::malloc(small_size);
		zassert_not_null(mem);
		std::free(mem);
	});
}

ZTEST(cpp_basic_alloc_new, test_calloc_chunk_OOM)
{
	test_alloc_OOM(false, [](){
		uint8_t* mem = (uint8_t*)std::malloc(malloc_stats.free_bytes+1);
		zassert_is_null(mem);
		std::free(mem);
	});
}

ZTEST(cpp_basic_alloc_new, test_new_array_OK)
{
	test_alloc_OK([](){
		uint8_t* mem = new uint8_t[small_size];
		zassert_not_null(mem);
		delete[] mem;
	});
}

ZTEST(cpp_basic_alloc_new, test_new_array_OOM)
{
	test_alloc_OOM(true, [](){
		uint8_t* mem = new uint8_t[malloc_stats.free_bytes+1];
		zassert_is_null(mem);
		delete[] mem;
		zassert_unreachable();
	});
}

ZTEST(cpp_basic_alloc_new, test_new_vector_OK)
{
	test_alloc_OK([](){
		std::vector<uint8_t> vec(small_size);
		zassert_equal(small_size, vec.size());
	});
}

ZTEST(cpp_basic_alloc_new, test_new_vector_OOM)
{
	test_alloc_OOM(true, [](){
		std::vector<uint8_t> vec(malloc_stats.free_bytes+1);
		zassert_not_equal(malloc_stats.free_bytes+1, vec.size());
		zassert_unreachable();
	});
}

ZTEST(cpp_basic_alloc_new, test_new_obj_OK)
{
	test_alloc_OK([](){
		Small *obj = new Small;
		zassert_not_null(obj);
		delete obj;
	});
}

ZTEST(cpp_basic_alloc_new, test_new_obj_OOM)
{
	zassert_true(oom_size > malloc_stats.free_bytes);
	test_alloc_OOM(true, [](){
		Big *obj = new Big;
		zassert_not_null(obj);
		delete obj;
		zassert_unreachable();
	});
}

static void before(void *arg)
{
	ARG_UNUSED(arg);
	if (!IS_ENABLED(CONFIG_COMMON_LIBC_MALLOC)) {
		ztest_test_skip();
	}
	if (!IS_ENABLED(CONFIG_SYS_HEAP_RUNTIME_STATS)) {
		ztest_test_skip();
	}
	if (!malloc_runtime_stats_get(&malloc_stats)) {
		dbg_PRINT("malloc stats: free %zu MB (%zu bytes)", 
			malloc_stats.free_bytes/size_t(1024UL*1024UL), malloc_stats.free_bytes);
	} else {
		ztest_test_skip();
	}


}

ZTEST_SUITE(cpp_basic_alloc_new, NULL, NULL, before, NULL, NULL);
```

## src/magic_statics.cpp
```c
/*
 * SPDX-License-Identifier: Apache-2.0 OR MPL-2.0 OR MIT
 *
 * If a copy of the Apache-2.0 license was not distributed with this file,
 * You can obtain one at https://www.apache.org/licenses/LICENSE-2.0.
 *
 * If a copy of the MPL-2.0 license was not distributed with this file,
 * You can obtain one at https://mozilla.org/MPL/2.0/.
 *
 * If a copy of the MIT license was not distributed with this file,
 * you can obtain one at https://opensource.org/license/mit/.
 */

#include <zephyr/ztest_assert.h>
#include <zephyr/kernel.h>
#include <zephyr/sys/util.h>
#include <zephyr/ztest.h>

#include <atomic>
#include <cstddef>
#include <cstdint>

// GNU C++ Library hooks for magic statics
// #include <ext/concurrence.h>

// #define dbg_PRINT(fmt, ...)
#define dbg_PRINT(fmt, ...)                                                                        \
	{                                                                                          \
		fprintf(stderr, "DBG @ magic_statics:%d %s: ", __LINE__, __func__);                \
		fprintf(stderr, (fmt)__VA_OPT__(, ) __VA_ARGS__);                                  \
		fputs("\n", stderr);                                                               \
	}

namespace
{

class TestObj
{
  public:
    uint32_t volatile memberVar;

    static std::atomic<uint8_t> callsToCtor;

    TestObj();
};

std::atomic<uint8_t> TestObj::callsToCtor = 0U;

TestObj::TestObj()
: memberVar(0U)
{
  callsToCtor++;
}


class TestClass
{
  public:
    TestObj* GetStaticTestObjInstance();
};

TestObj* TestClass::GetStaticTestObjInstance()
{
  static TestObj uut;
  return &uut;
}

} // anonymous namespace

ZTEST(cpp_basic_magic_statics, test_magic_statics) // NOLINT
{
  dbg_PRINT("TestObj::callsToCtor %d", TestObj::callsToCtor.load());

  TestClass testClassInstanceA;
  TestClass testClassInstanceB;

  TestObj* p1 = testClassInstanceA.GetStaticTestObjInstance();
  TestObj* p2 = testClassInstanceB.GetStaticTestObjInstance();

  zassert_equal_ptr(p1, p2);
  zassert_equal(TestObj::callsToCtor, 1);

  // number of runs, visible to the debugger
  p1->memberVar++;
  dbg_PRINT("p1->memberVar %d", p1->memberVar);

}

static void before(void *arg)
{
	ARG_UNUSED(arg);
	// No constraints
	// CONFIG_MAX_PTHREAD_COND_COUNT 5 (default)
	dbg_PRINT("CONFIG_MAX_PTHREAD_COND_COUNT %d", CONFIG_MAX_PTHREAD_COND_COUNT);
}

ZTEST_SUITE(cpp_basic_magic_statics, NULL, NULL, before, NULL, NULL);
```
