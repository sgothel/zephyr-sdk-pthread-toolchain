## tests/cpp/concurrency/testcase.yaml
```yaml
common:
  tags:
    - cpp
    - concurrency
    - posix
    - pthread
  min_ram: 64
  timeout: 240
  # 1 tier0 platform per supported architecture
  platform_key:
    - arch
    - simulation
  filter: not CONFIG_NATIVE_LIBC
tests:
  cpp.concurrency.base.tls:
    platform_exclude:
      - intel_ehl_crb
    filter: CONFIG_ARCH_HAS_THREAD_LOCAL_STORAGE and CONFIG_TOOLCHAIN_SUPPORTS_THREAD_LOCAL_STORAGE
    extra_args:
      - arch:x86:CONFIG_NO_OPTIMIZATIONS=y
  cpp.concurrency.static_stack.tls:
    platform_exclude:
      - intel_ehl_crb
    filter: CONFIG_ARCH_HAS_THREAD_LOCAL_STORAGE and CONFIG_TOOLCHAIN_SUPPORTS_THREAD_LOCAL_STORAGE
    extra_configs:
      - CONFIG_DYNAMIC_THREAD=n
      - CONFIG_THREAD_STACK_INFO=n
    extra_args:
      - arch:x86:CONFIG_NO_OPTIMIZATIONS=y
```

## tests/cpp_pthread/testcase.yaml
```yaml
common:
  tags:
    - posix
    - pthread
    - cpp
  min_ram: 64
  timeout: 240
  # 1 tier0 platform per supported architecture
  platform_key:
    - arch
    - simulation
  filter: not CONFIG_NATIVE_LIBC
tests:
  posix.pthread.dynamic_stack:
    extra_configs:
      - CONFIG_DYNAMIC_THREAD=y
      - CONFIG_THREAD_STACK_INFO=y
      - CONFIG_HEAP_MEM_POOL_SIZE=16384
      - CONFIG_POSIX_THREAD_KEYS_MAX=2048
      - CONFIG_TEST_EXTRA_STACK_SIZE=16384
  posix.pthread.dynamic_stack.tls:
    platform_exclude:
      - intel_ehl_crb
    filter: CONFIG_ARCH_HAS_THREAD_LOCAL_STORAGE and CONFIG_TOOLCHAIN_SUPPORTS_THREAD_LOCAL_STORAGE
    extra_configs:
      - CONFIG_THREAD_LOCAL_STORAGE=y
      - CONFIG_DYNAMIC_THREAD=y
      - CONFIG_THREAD_STACK_INFO=y
      - CONFIG_HEAP_MEM_POOL_SIZE=16384
      - CONFIG_POSIX_THREAD_KEYS_MAX=2048
      - CONFIG_TEST_EXTRA_STACK_SIZE=16384
```

## tests/pthread/testcase.yaml
```yaml
common:
  tags:
    - posix
    - pthread
    - concurrency
  min_ram: 64
  timeout: 240
  filter: not CONFIG_NATIVE_LIBC
tests:
  pthread.dynamic_stack:
    extra_configs:
      - CONFIG_DYNAMIC_THREAD=y
      - CONFIG_THREAD_STACK_INFO=y
      - CONFIG_HEAP_MEM_POOL_SIZE=16384
      - CONFIG_POSIX_THREAD_KEYS_MAX=2048
      - CONFIG_TEST_EXTRA_STACK_SIZE=16384
  pthread.dynamic_stack.tls:
    platform_exclude:
      - intel_ehl_crb
    filter: CONFIG_ARCH_HAS_THREAD_LOCAL_STORAGE and CONFIG_TOOLCHAIN_SUPPORTS_THREAD_LOCAL_STORAGE
    extra_configs:
      - CONFIG_THREAD_LOCAL_STORAGE=y
      - CONFIG_DYNAMIC_THREAD=y
      - CONFIG_THREAD_STACK_INFO=y
      - CONFIG_HEAP_MEM_POOL_SIZE=16384
      - CONFIG_POSIX_THREAD_KEYS_MAX=2048
      - CONFIG_TEST_EXTRA_STACK_SIZE=16384
  pthread.static_stack:
    extra_configs:
      - CONFIG_DYNAMIC_THREAD=n
      - CONFIG_THREAD_STACK_INFO=n
```
