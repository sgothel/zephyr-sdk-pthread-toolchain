## CMakeLists.txt
```
# SPDX-License-Identifier: Apache-2.0

cmake_minimum_required(VERSION 3.20.0)
find_package(Zephyr REQUIRED HINTS $ENV{ZEPHYR_BASE})
project(posix_pthread)

get_filename_component(TESTS_DIR "${CMAKE_CURRENT_SOURCE_DIR}" DIRECTORY)
get_filename_component(PROJECT_REPO_ROOT "${TESTS_DIR}" DIRECTORY)
include(${PROJECT_REPO_ROOT}/cmake/ClangdSetup.cmake)
ClangdSetup()

FILE(GLOB app_sources src/*.c)
zephyr_include_directories(${ZEPHYR_BASE}/subsys/portability/posix)

target_sources(app PRIVATE ${app_sources})

target_compile_options(app PRIVATE -U_POSIX_C_SOURCE -D_POSIX_C_SOURCE=200809L)
target_include_directories(app PRIVATE ${ZEPHYR_BASE}/subsys/portability/posix/options)
```

## prj.conf
```kconfig
CONFIG_POSIX_API=y
CONFIG_PTHREAD_CREATE_BARRIER=y
CONFIG_ZTEST=y
CONFIG_POSIX_SEM_VALUE_MAX=32767
CONFIG_POSIX_MESSAGE_PASSING=y
CONFIG_POSIX_PRIORITY_SCHEDULING=y
CONFIG_HEAP_MEM_POOL_SIZE=4096
CONFIG_THREAD_NAME=y
CONFIG_DYNAMIC_THREAD=y
CONFIG_THREAD_STACK_INFO=y

CONFIG_POSIX_THREAD_THREADS_MAX=6
CONFIG_DYNAMIC_THREAD_POOL_SIZE=6
CONFIG_MAX_PTHREAD_COND_COUNT=7

CONFIG_POSIX_THREAD_KEYS_MAX=512
CONFIG_TEST_EXTRA_STACK_SIZE=4096

CONFIG_PTHREAD_CREATE_BARRIER=y

# CONFIG_LOG_DEFAULT_LEVEL=4

# Thread Safety
#CONFIG_COMMON_LIBC_ASCTIME_R=y
#CONFIG_COMMON_LIBC_CTIME_R=y
CONFIG_POSIX_C_LANG_SUPPORT_R=y
CONFIG_POSIX_FILE_SYSTEM_R=y
CONFIG_POSIX_THREAD_SAFE_FUNCTIONS=y

# for fnmatch()
CONFIG_POSIX_C_LIB_EXT=y

# for putmsg()
CONFIG_XSI_STREAMS=y

# for sleep(), getpid()
CONFIG_POSIX_MULTI_PROCESS=y

# for syslog()
CONFIG_XSI_SYSTEM_LOGGING=y

# for sched_get_priority_min(), sched_get_priority_max()
CONFIG_POSIX_PRIORITY_SCHEDULING=y
```

## src/pthread.c
```c
/*
 * Copyright (c) 2018-2023 Intel Corporation
 *
 * SPDX-License-Identifier: Apache-2.0
 */

#include <pthread.h>
#include <semaphore.h>
#include <time.h>

#include <zephyr/sys/util.h>
#include <zephyr/ztest.h>

// #define dbg_PRINT(fmt, ...)
#define dbg_PRINT(fmt, ...)                                                                        \
	{                                                                                          \
		fprintf(stderr, "DBG @ pthread:%d %s: ", __LINE__, __func__);                      \
		fprintf(stderr, (fmt)__VA_OPT__(, ) __VA_ARGS__);                                  \
		fputs("\n", stderr);                                                               \
	}

#define DETACH_THR_ID 2

#define N_THR_E    3
#define N_THR_T    4
#define BOUNCES    64
#define ONE_SECOND 1

/* Macros to test invalid states */
#define PTHREAD_CANCEL_INVALID -1
#define SCHED_INVALID          -1
#define PRIO_INVALID           -1
#define PTHREAD_INVALID        -1

static void *thread_top_exec(void *p1);
static void *thread_top_term(void *p1);

static pthread_mutex_t lock = PTHREAD_MUTEX_INITIALIZER;
static pthread_cond_t cvar0 = PTHREAD_COND_INITIALIZER;
static pthread_cond_t cvar1 = PTHREAD_COND_INITIALIZER;
static pthread_barrier_t barrier;

static sem_t main_sem;

static int bounce_failed;
static int bounce_done[N_THR_E];

static int curr_bounce_thread;

static int barrier_failed;
static int barrier_done[N_THR_E];
static int barrier_return[N_THR_E];

/* First phase bounces execution between two threads using a condition
 * variable, continuously testing that no other thread is mucking with
 * the protected state.  This ends with all threads going back to
 * sleep on the condition variable and being woken by main() for the
 * second phase.
 *
 * Second phase simply lines up all the threads on a barrier, verifies
 * that none run until the last one enters, and that all run after the
 * exit.
 *
 * Test success is signaled to main() using a traditional semaphore.
 */

static void *thread_top_exec(void *p1)
{
	int i, j, id = (int)POINTER_TO_INT(p1);
	int policy;
	struct sched_param schedparam;

	pthread_getschedparam(pthread_self(), &policy, &schedparam);
	printk("Thread %d starting with scheduling policy %d & priority %d\n", id, policy,
	       schedparam.sched_priority);
	/* Try a double-lock here to exercise the failing case of
	 * trylock.  We don't support RECURSIVE locks, so this is
	 * guaranteed to fail.
	 */
	pthread_mutex_lock(&lock);

	if (!pthread_mutex_trylock(&lock)) { /* NOSONAR */
		printk("pthread_mutex_trylock inexplicably succeeded\n");
		bounce_failed = 1;
	}

	pthread_mutex_unlock(&lock);

	for (i = 0; i < BOUNCES; i++) {

		pthread_mutex_lock(&lock);

		/* Wait for the current owner to signal us, unless we
		 * are the very first thread, in which case we need to
		 * wait a bit to be sure the other threads get
		 * scheduled and wait on cvar0.
		 */
		if (!(id == 0 && i == 0)) {
			zassert_equal(0, pthread_cond_wait(&cvar0, &lock), "");
		} else {
			pthread_mutex_unlock(&lock);
			usleep(USEC_PER_MSEC * 500U);
			pthread_mutex_lock(&lock);
		}

		/* Claim ownership, then try really hard to give someone
		 * else a shot at hitting this if they are racing.
		 */
		curr_bounce_thread = id;
		for (j = 0; j < 1000; j++) {
			if (curr_bounce_thread != id) {
				printk("Racing bounce threads\n");
				bounce_failed = 1;
				sem_post(&main_sem);
				pthread_mutex_unlock(&lock);
				return NULL;
			}
			sched_yield();
		}

		/* Next one's turn, go back to the top and wait.  */
		pthread_cond_signal(&cvar0);
		pthread_mutex_unlock(&lock);
	}

	/* Signal we are complete to main(), then let it wake us up.  Note
	 * that we are using the same mutex with both cvar0 and cvar1,
	 * which is non-standard but kosher per POSIX (and it works fine
	 * in our implementation
	 */
	pthread_mutex_lock(&lock);
	bounce_done[id] = 1;
	sem_post(&main_sem);
	pthread_cond_wait(&cvar1, &lock);
	pthread_mutex_unlock(&lock);

	/* Now just wait on the barrier.  Make sure no one else finished
	 * before we wait on it, then signal that we're done
	 */
	for (i = 0; i < N_THR_E; i++) {
		if (barrier_done[i]) {
			printk("Barrier exited early\n");
			barrier_failed = 1;
			sem_post(&main_sem);
		}
	}
	barrier_return[id] = pthread_barrier_wait(&barrier);
	barrier_done[id] = 1;
	sem_post(&main_sem);
	pthread_exit(p1);

	return NULL;
}

static void *timedjoin_thread(void *p1)
{
	int sleep_duration_ms = POINTER_TO_INT(p1);

	usleep(USEC_PER_MSEC * sleep_duration_ms);
	return NULL;
}

static int bounce_test_done(void)
{
	int i;

	if (bounce_failed) {
		return 1;
	}

	for (i = 0; i < N_THR_E; i++) {
		if (!bounce_done[i]) {
			return 0;
		}
	}

	return 1;
}

static int barrier_test_done(void)
{
	int i;

	if (barrier_failed) {
		return 1;
	}

	for (i = 0; i < N_THR_E; i++) {
		if (!barrier_done[i]) {
			return 0;
		}
	}

	return 1;
}

static void *thread_top_term(void *p1)
{
	pthread_t self;
	int policy, ret;
	int id = POINTER_TO_INT(p1);
	struct sched_param param, getschedparam;

	param.sched_priority = N_THR_T - id;

	self = pthread_self();

	/* Change priority of thread */
	zassert_false(pthread_setschedparam(self, SCHED_RR, &param),
		      "Unable to set thread priority!");

	zassert_false(pthread_getschedparam(self, &policy, &getschedparam),
		      "Unable to get thread priority!");

	printk("Thread %d starting with a priority of %d\n", id, getschedparam.sched_priority);

	if (id % 2) {
		ret = pthread_setcancelstate(PTHREAD_CANCEL_DISABLE, NULL);
		zassert_false(ret, "Unable to set cancel state!");
	}

	if (id >= DETACH_THR_ID) {
		zassert_ok(pthread_detach(self), "failed to set detach state");
		zassert_equal(pthread_detach(self), EINVAL, "re-detached thread!");
	}

	printk("Cancelling thread %d\n", id);
	pthread_cancel(self);
	printk("Thread %d could not be cancelled\n", id);
	sleep(ONE_SECOND);
	pthread_exit(p1);
	return NULL;
}

/* Test the internal priority conversion functions */
int zephyr_to_posix_priority(int z_prio, int *policy);
int posix_to_zephyr_priority(int priority, int policy);
ZTEST(pthread, test_pthread_priority_conversion)
{
	/*
	 *    ZEPHYR [-CONFIG_NUM_COOP_PRIORITIES, -1]
	 *                       TO
	 * POSIX(FIFO) [0, CONFIG_NUM_COOP_PRIORITIES - 1]
	 */
	for (int z_prio = -CONFIG_NUM_COOP_PRIORITIES, prio = CONFIG_NUM_COOP_PRIORITIES - 1,
		 p_prio, policy;
	     z_prio <= -1; z_prio++, prio--) {
		p_prio = zephyr_to_posix_priority(z_prio, &policy);
		zassert_equal(policy, SCHED_FIFO);
		zassert_equal(p_prio, prio, "%d %d\n", p_prio, prio);
		zassert_equal(z_prio, posix_to_zephyr_priority(p_prio, SCHED_FIFO));
	}

	/*
	 *  ZEPHYR [0, CONFIG_NUM_PREEMPT_PRIORITIES - 1]
	 *                      TO
	 * POSIX(RR) [0, CONFIG_NUM_PREEMPT_PRIORITIES - 1]
	 */
	for (int z_prio = 0, prio = CONFIG_NUM_PREEMPT_PRIORITIES - 1, p_prio, policy;
	     z_prio < CONFIG_NUM_PREEMPT_PRIORITIES; z_prio++, prio--) {
		p_prio = zephyr_to_posix_priority(z_prio, &policy);
		zassert_equal(policy, SCHED_RR);
		zassert_equal(p_prio, prio, "%d %d\n", p_prio, prio);
		zassert_equal(z_prio, posix_to_zephyr_priority(p_prio, SCHED_RR));
	}
}

ZTEST(pthread, test_pthread_execution)
{
	int i, ret;
	pthread_t newthread[N_THR_E];
	void *retval;
	int serial_threads = 0;
	static const char thr_name[] = "thread name";
	char thr_name_buf[CONFIG_THREAD_MAX_NAME_LEN];

	/*
	 * initialize barriers the standard way after deprecating
	 * PTHREAD_BARRIER_DEFINE().
	 */
	zassert_ok(pthread_barrier_init(&barrier, NULL, N_THR_E));

	sem_init(&main_sem, 0, 1);

	/* TESTPOINT: Try getting name of NULL thread (aka uninitialized
	 * thread var).
	 */
	ret = pthread_getname_np(PTHREAD_INVALID, thr_name_buf, sizeof(thr_name_buf));
	zassert_equal(ret, ESRCH, "uninitialized getname!");

	for (i = 0; i < N_THR_E; i++) {
		ret = pthread_create(&newthread[i], NULL, thread_top_exec, INT_TO_POINTER(i));
	}

	/* TESTPOINT: Try setting name of NULL thread (aka uninitialized
	 * thread var).
	 */
	ret = pthread_setname_np(PTHREAD_INVALID, thr_name);
	zassert_equal(ret, ESRCH, "uninitialized setname!");

	/* TESTPOINT: Try getting thread name with no buffer */
	ret = pthread_getname_np(newthread[0], NULL, sizeof(thr_name_buf));
	zassert_equal(ret, EINVAL, "uninitialized getname!");

	/* TESTPOINT: Try setting thread name with no buffer */
	ret = pthread_setname_np(newthread[0], NULL);
	zassert_equal(ret, EINVAL, "uninitialized setname!");

	/* TESTPOINT: Try setting thread name */
	ret = pthread_setname_np(newthread[0], thr_name);
	zassert_false(ret, "Set thread name failed!");

	/* TESTPOINT: Try getting thread name */
	ret = pthread_getname_np(newthread[0], thr_name_buf, sizeof(thr_name_buf));
	zassert_false(ret, "Get thread name failed!");

	/* TESTPOINT: Thread names match */
	ret = strncmp(thr_name, thr_name_buf, MIN(strlen(thr_name), strlen(thr_name_buf)));
	zassert_false(ret, "Thread names don't match!");

	while (!bounce_test_done()) {
		sem_wait(&main_sem);
	}

	/* TESTPOINT: Check if bounce test passes */
	zassert_false(bounce_failed, "Bounce test failed");

	printk("Bounce test OK\n");

	/* Wake up the worker threads */
	pthread_mutex_lock(&lock);
	pthread_cond_broadcast(&cvar1);
	pthread_mutex_unlock(&lock);

	while (!barrier_test_done()) {
		sem_wait(&main_sem);
	}

	/* TESTPOINT: Check if barrier test passes */
	zassert_false(barrier_failed, "Barrier test failed");

	for (i = 0; i < N_THR_E; i++) {
		pthread_join(newthread[i], &retval);
	}

	for (i = 0; i < N_THR_E; i++) {
		if (barrier_return[i] == PTHREAD_BARRIER_SERIAL_THREAD) {
			++serial_threads;
		}
	}

	/* TESTPOINT: Check only one PTHREAD_BARRIER_SERIAL_THREAD returned. */
	zassert_true(serial_threads == 1, "Bungled barrier return value(s)");

	printk("Barrier test OK\n");
}

ZTEST(pthread, test_pthread_termination)
{
	int32_t i, ret;
	pthread_t newthread[N_THR_T] = {0};
	void *retval;

	/* Creating 4 threads */
	for (i = 0; i < N_THR_T; i++) {
		zassert_ok(pthread_create(&newthread[i], NULL, thread_top_term, INT_TO_POINTER(i)));
	}

	/* TESTPOINT: Try setting invalid cancel state to current thread */
	ret = pthread_setcancelstate(PTHREAD_CANCEL_INVALID, NULL);
	zassert_equal(ret, EINVAL, "invalid cancel state set!");

	for (i = 0; i < N_THR_T; i++) {
		if (i < DETACH_THR_ID) {
			zassert_ok(pthread_join(newthread[i], &retval));
		}
	}

	/* TESTPOINT: Test for deadlock */
	ret = pthread_join(pthread_self(), &retval);
	zassert_equal(ret, EDEADLK, "thread joined with self inexplicably!");

	/* TESTPOINT: Try canceling a terminated thread */
	ret = pthread_cancel(newthread[0]);
	zassert_equal(ret, ESRCH, "cancelled a terminated thread!");
}

ZTEST(pthread, test_pthread_tryjoin)
{
	pthread_t th = {0};
	int sleep_duration_ms = 200;
	void *retval;

	/* Creating a thread that exits after 200ms*/
	zassert_ok(pthread_create(&th, NULL, timedjoin_thread, INT_TO_POINTER(sleep_duration_ms)));

	/* Attempting to join, when thread is still running, should fail */
	usleep(USEC_PER_MSEC * sleep_duration_ms / 2);
	zassert_equal(pthread_tryjoin_np(th, &retval), EBUSY);

	/* Sleep so thread will exit */
	usleep(USEC_PER_MSEC * sleep_duration_ms);

	/* Attempting to join without blocking should succeed now */
	zassert_ok(pthread_tryjoin_np(th, &retval));
}

ZTEST(pthread, test_pthread_timedjoin)
{
	pthread_t th = {0};
	int sleep_duration_ms = 200;
	void *ret;
	struct timespec not_done;
	struct timespec done;
	struct timespec invalid[] = {
		{.tv_nsec = -1},
		{.tv_nsec = NSEC_PER_SEC},
	};

	/* setup timespecs when the thread is still running and when it is done */
	clock_gettime(CLOCK_REALTIME, &not_done);
	clock_gettime(CLOCK_REALTIME, &done);
	not_done.tv_nsec += sleep_duration_ms / 2 * NSEC_PER_MSEC;
	done.tv_nsec += sleep_duration_ms * 1.5 * NSEC_PER_MSEC;
	while (not_done.tv_nsec >= NSEC_PER_SEC) {
		not_done.tv_sec++;
		not_done.tv_nsec -= NSEC_PER_SEC;
	}
	while (done.tv_nsec >= NSEC_PER_SEC) {
		done.tv_sec++;
		done.tv_nsec -= NSEC_PER_SEC;
	}

	/* Creating a thread that exits after 200ms*/
	zassert_ok(pthread_create(&th, NULL, timedjoin_thread, INT_TO_POINTER(sleep_duration_ms)));

	/* pthread_timedjoin-np must return EINVAL for invalid struct timespecs */
	zassert_equal(pthread_timedjoin_np(th, &ret, NULL), EINVAL);
	for (size_t i = 0; i < ARRAY_SIZE(invalid); ++i) {
		zassert_equal(pthread_timedjoin_np(th, &ret, &invalid[i]), EINVAL);
	}

	/* Attempting to join with a timeout, when the thread is still running should fail */
	zassert_equal(pthread_timedjoin_np(th, &ret, &not_done), ETIMEDOUT);

	/* Attempting to join with a timeout, when the thread is done, should succeed */
	zassert_ok(pthread_timedjoin_np(th, &ret, &done));
}

static void *create_thread1(void *p1)
{
	/* do nothing */
	return NULL;
}

ZTEST(pthread, test_pthread_descriptor_leak)
{
	pthread_t pthread1;

	/* If we are leaking descriptors, then this loop will never complete */
	for (size_t i = 0; i < CONFIG_POSIX_THREAD_THREADS_MAX * 2; ++i) {
		zassert_ok(pthread_create(&pthread1, NULL, create_thread1, NULL),
			   "unable to create thread %zu", i);
		zassert_ok(pthread_join(pthread1, NULL), "unable to join thread %zu", i);
	}
}

ZTEST(pthread, test_pthread_equal)
{
	zassert_true(pthread_equal(pthread_self(), pthread_self()));
	zassert_false(pthread_equal(pthread_self(), (pthread_t)4242));
}

static atomic_t test_cleanup_flags = ATOMIC_INIT(0);
#define TEST_CLEANUP_DONE_BIT 0

static void cleanup_handler(void *arg)
{
	bool *boolp = (bool *)arg;

	*boolp = true;
}

static void *test_pthread_cleanup_entry_explicit(void *arg)
{
	bool executed[2] = {false, false};

	ARG_UNUSED(arg);
	pthread_cleanup_push(cleanup_handler, &executed[0]);
	pthread_cleanup_push(cleanup_handler, &executed[1]);
	pthread_cleanup_pop(false);
	pthread_cleanup_pop(true);

	zassert_equal(true, executed[0]);
	zassert_equal(false, executed[1]);

	return NULL;
}

static void *test_pthread_cleanup_entry_pexit(void *arg)
{
	bool *executedp = (bool *)arg;

	pthread_cleanup_push(cleanup_handler, executedp + 0); /* NOSONAR */
	pthread_cleanup_push(cleanup_handler, executedp + 1); /* NOSONAR */

	if (atomic_test_bit(&test_cleanup_flags, TEST_CLEANUP_DONE_BIT)) {
		/* will exit this user thread-func and execute cleanup-handler */
		pthread_exit(executedp);
	}

	pthread_cleanup_pop(false);
	pthread_cleanup_pop(false);
	zassert_unreachable();
	return NULL;
}

static void *test_pthread_cleanup_entry_cancelsync(void *arg)
{
	bool *executedp = (bool *)arg;

	pthread_cleanup_push(cleanup_handler, executedp + 0); /* NOSONAR */
	pthread_cleanup_push(cleanup_handler, executedp + 1); /* NOSONAR */

	while (true) {
		/* Will exit this user thread-func and execute cleanup-handler. */
		pthread_testcancel();
		k_yield(); /* be more cooperative */
	}

	pthread_cleanup_pop(false);
	pthread_cleanup_pop(false);
	zassert_unreachable();
	return NULL;
}

static void *test_pthread_cleanup_entry_return(void *arg)
{
	bool *executedp = (bool *)arg;

	pthread_cleanup_push(cleanup_handler, executedp + 0); /* NOSONAR */
	pthread_cleanup_push(cleanup_handler, executedp + 1); /* NOSONAR */
	if (atomic_test_bit(&test_cleanup_flags, TEST_CLEANUP_DONE_BIT)) {
		/* will exit this user thread-func without executing cleanup-handler */
		return executedp;
	}
	pthread_cleanup_pop(true);
	pthread_cleanup_pop(true);
	zassert_unreachable();
	return NULL;
}

ZTEST(pthread, test_pthread_cleanup0_explicit)
{
	pthread_t th;

	zassert_ok(pthread_create(&th, NULL, test_pthread_cleanup_entry_explicit, NULL));
	zassert_ok(pthread_join(th, NULL));
}

ZTEST(pthread, test_pthread_cleanup1_pexit)
{
	pthread_t th;
	bool executed[2] = {false, false};
	void *retval = NULL;

	atomic_set_bit(&test_cleanup_flags, TEST_CLEANUP_DONE_BIT);
	zassert_ok(pthread_create(&th, NULL, test_pthread_cleanup_entry_pexit, executed));
	zassert_ok(pthread_join(th, &retval));
	zassert_equal_ptr(retval, executed);
	zassert_equal(true, executed[0]);
	zassert_equal(true, executed[1]);
}

ZTEST(pthread, test_pthread_cleanup2_cancel_sync)
{
	pthread_t th;
	bool executed[2] = {false, false};
	void *retval = NULL;

	zassert_ok(pthread_create(&th, NULL, test_pthread_cleanup_entry_cancelsync, executed));
	zassert_ok(pthread_cancel(th));
	zassert_ok(pthread_join(th, &retval));
	zassert_equal_ptr(retval, PTHREAD_CANCELED);
	zassert_equal(true, executed[0]);
	zassert_equal(true, executed[1]);
}

ZTEST(pthread, test_pthread_cleanup3_return)
{
	pthread_t th;
	bool executed[2] = {false, false};
	void *retval = NULL;

	atomic_set_bit(&test_cleanup_flags, TEST_CLEANUP_DONE_BIT);
	zassert_ok(pthread_create(&th, NULL, test_pthread_cleanup_entry_return, executed));
	zassert_ok(pthread_join(th, &retval));
	zassert_equal_ptr(retval, executed);
	zassert_equal(false, executed[0]);
	zassert_equal(false, executed[1]);
}

static bool testcancel_ignored;
static bool testcancel_failed;

static void *test_pthread_cancel0_self_fn(void *arg)
{
	zassert_ok(pthread_setcancelstate(PTHREAD_CANCEL_DISABLE, NULL));

	testcancel_ignored = false;

	/* this should be ignored */
	pthread_testcancel();

	testcancel_ignored = true;

	/* this will mark it pending */
	zassert_ok(pthread_cancel(pthread_self()));

	/* enable the thread to be cancelled */
	zassert_ok(pthread_setcancelstate(PTHREAD_CANCEL_ENABLE, NULL));

	testcancel_failed = false;

	/* this should terminate the thread */
	pthread_testcancel();

	testcancel_failed = true;
	zassert_unreachable();

	return NULL;
}

ZTEST(pthread, test_pthread_testcancel0_self)
{
	pthread_t th;
	void *retval = NULL;

	zassert_ok(pthread_create(&th, NULL, test_pthread_cancel0_self_fn, NULL));
	zassert_ok(pthread_join(th, &retval));
	zassert_equal_ptr(retval, PTHREAD_CANCELED);
	zassert_true(testcancel_ignored);
	zassert_false(testcancel_failed);
}

static atomic_t test_cancel_flags = ATOMIC_INIT(0);
#define TEST_CANCEL_ENABLED_BIT 0
#define TEST_CANCEL_SET_BIT     1

static void *test_pthread_cancel1_ext_fn(void *arg)
{
	zassert_ok(pthread_setcancelstate(PTHREAD_CANCEL_DISABLE, NULL));

	testcancel_ignored = false;

	/* this should be ignored */
	pthread_testcancel();

	testcancel_ignored = true;

	/* enable the thread to be cancelled */
	zassert_ok(pthread_setcancelstate(PTHREAD_CANCEL_ENABLE, NULL));
	atomic_set_bit(&test_cancel_flags, TEST_CANCEL_ENABLED_BIT);
	while (!atomic_test_bit(&test_cancel_flags, TEST_CANCEL_SET_BIT)) {
		k_yield();
	}

	testcancel_failed = false;

	/* this should terminate the thread */
	pthread_testcancel();

	testcancel_failed = true;
	zassert_unreachable();

	return NULL;
}

ZTEST(pthread, test_pthread_testcancel1_ext)
{
	pthread_t th;
	void *retval = NULL;

	atomic_clear(&test_cancel_flags);
	zassert_ok(pthread_create(&th, NULL, test_pthread_cancel1_ext_fn, NULL));
	while (!atomic_test_bit(&test_cancel_flags, TEST_CANCEL_ENABLED_BIT)) {
		k_yield();
	}
	zassert_ok(pthread_cancel(th));
	atomic_set_bit(&test_cancel_flags, TEST_CANCEL_SET_BIT);
	zassert_ok(pthread_join(th, &retval));
	zassert_equal_ptr(retval, PTHREAD_CANCELED);
	zassert_true(testcancel_ignored);
	zassert_false(testcancel_failed);
}

static void *test_pthread_cancel2_ext_fn(void *arg)
{
	testcancel_failed = false;

	while (true) {
		/* this should terminate the thread */
		pthread_testcancel();
		k_yield(); /* be more cooperative */
	}

	testcancel_failed = true;
	zassert_unreachable();

	return NULL;
}

ZTEST(pthread, test_pthread_testcancel2_ext)
{
	pthread_t th;
	void *retval = NULL;

	zassert_ok(pthread_create(&th, NULL, test_pthread_cancel2_ext_fn, NULL));
	zassert_ok(pthread_cancel(th));
	zassert_ok(pthread_join(th, &retval));
	zassert_equal_ptr(retval, PTHREAD_CANCELED);
	zassert_false(testcancel_failed);
}

static void *test_pthread_setschedprio_fn(void *arg)
{
	int policy;
	int prio = 0;
	struct sched_param param;
	pthread_t self = pthread_self();

	zassert_equal(pthread_setschedprio(self, PRIO_INVALID), EINVAL, "EINVAL was expected");
	zassert_equal(pthread_setschedprio(PTHREAD_INVALID, prio), ESRCH, "ESRCH was expected");

	zassert_ok(pthread_setschedprio(self, prio));
	param.sched_priority = ~prio;
	zassert_ok(pthread_getschedparam(self, &policy, &param));
	zassert_equal(param.sched_priority, prio, "Priority unchanged");

	return NULL;
}

ZTEST(pthread, test_pthread_setschedprio)
{
	pthread_t th;

	zassert_ok(pthread_create(&th, NULL, test_pthread_setschedprio_fn, NULL));
	zassert_ok(pthread_join(th, NULL));
}

ZTEST(pthread, test_pthread_setschedprio_main)
{
	test_pthread_setschedprio_fn(NULL);
}

static void *test_pthread_getschedparam_fn(void *arg)
{
	int act_policy = 0, res;
	struct sched_param param;
	pthread_t self = pthread_self();

	zassert_ok(pthread_getschedparam(self, &act_policy, &param));
	res = act_policy == SCHED_FIFO || act_policy == SCHED_RR;
	zassert_true(res);

	return NULL;
}

ZTEST(pthread, test_pthread_getschedparam)
{
	pthread_t th;

	zassert_ok(pthread_create(&th, NULL, test_pthread_getschedparam_fn, NULL));
	zassert_ok(pthread_join(th, NULL));
}

ZTEST(pthread, test_pthread_getschedparam_main)
{
	test_pthread_getschedparam_fn(NULL);
}

static char pthread_name_glob_name[80];

static void *test_pthread_name_fn(void *arg)
{
	char name[80];
	int res;
	pthread_t self = pthread_self();

	pthread_mutex_lock(&lock);
	pthread_cond_signal(&cvar0);
	pthread_cond_wait(&cvar1, &lock);

	zassert_ok(pthread_getname_np(self, name, sizeof(name)));
	res = strncmp("CreateThreadName", name, sizeof(name));
	zassert_equal(0, res, "Creation Thread-Name (pthread)");

	zassert_ok(pthread_setname_np(self, "ChangdThreadName"));
	zassert_ok(pthread_getname_np(self, name, sizeof(name)));
	res = strncmp("ChangdThreadName", name, sizeof(name));
	zassert_equal(0, res, "Changed Thread-Name (pthread)");
	strncpy(pthread_name_glob_name, name, sizeof(name));

	pthread_mutex_unlock(&lock);

	return NULL;
}

ZTEST(pthread, test_pthread_name)
{
	char name[80];
	int res;
	pthread_t th;

	pthread_mutex_lock(&lock);
	zassert_ok(pthread_create(&th, NULL, test_pthread_name_fn, NULL));
	pthread_cond_wait(&cvar0, &lock);

	zassert_ok(pthread_setname_np(th, "CreateThreadName"));
	zassert_ok(pthread_getname_np(th, name, sizeof(name)));
	res = strncmp("CreateThreadName", name, sizeof(name));
	zassert_equal(0, res, "Create Thread-Name (main)");
	pthread_cond_signal(&cvar1);
	pthread_mutex_unlock(&lock);

	zassert_ok(pthread_join(th, NULL));

	if (pthread_getname_np(th, name, sizeof(name)) == 0) {
		res = strncmp("ChangdThreadName", name, sizeof(name));
		dbg_PRINT("post_join: th-name %s", name);
		zassert_equal(0, res, "Changed Thread-Name (main)");
	} /* else thread th could be already dead, OK */

	dbg_PRINT("post_join: glob-name %s", name);
	res = strncmp("ChangdThreadName", pthread_name_glob_name, sizeof(pthread_name_glob_name));
	zassert_equal(0, res, "Changed Thread-Name (main, global)");
}

ZTEST(pthread, test_pthread_name_main)
{
	char name[80];
	int res;
	pthread_t self = pthread_self();

	zassert_not_equal(0, self);

	zassert_ok(pthread_setname_np(self, "MainThreadName"));
	zassert_ok(pthread_getname_np(self, name, sizeof(name)));
	res = strncmp("MainThreadName", name, sizeof(name));
	zassert_equal(0, res, "Main Thread-Name");
}

static void before(void *arg)
{
	ARG_UNUSED(arg);

	if (IS_ENABLED(CONFIG_DYNAMIC_THREAD)) {
		dbg_PRINT("CONFIG_SMP enabled");
	} else {
		dbg_PRINT("CONFIG_SMP disabled");
	}
	if (!IS_ENABLED(CONFIG_DYNAMIC_THREAD)) {
		/* skip redundant testing if there is no thread pool / heap allocation */
		ztest_test_skip();
	}
}

ZTEST_SUITE(pthread, NULL, NULL, before, NULL, NULL);
```

## src/pthread_once.c
```c
/*
 * Copyright (c) 2026 Göthel Software
 *
 * SPDX-License-Identifier: Apache-2.0 OR MIT
 *
 * If a copy of the Apache-2.0 license was not distributed with this file,
 * You can obtain one at https://www.apache.org/licenses/LICENSE-2.0.
 *
 * If a copy of the MIT license was not distributed with this file,
 * you can obtain one at https://opensource.org/license/mit/.
 */

#include <pthread.h>

#include <zephyr/kernel.h>
#include <zephyr/sys/util.h>
#include <zephyr/ztest.h>
#include <zephyr/sys/atomic.h>
#include <zephyr/sys/atomic_types.h>

#define DEBUG_OUTPUT 1

#ifdef DEBUG_OUTPUT

#define dbg_PRINT(fmt, ...)                                                                        \
	{                                                                                          \
		char name[20];                                                                     \
                                                                                                   \
		pthread_getname_np(pthread_self(), name, sizeof(name));                            \
		fputs(name, stderr);                                                               \
		fputs(": ", stderr);                                                               \
		fprintf(stderr, (fmt)__VA_OPT__(,) __VA_ARGS__);                                   \
		fflush(stderr);                                                                    \
	}

#else

#define dbg_PRINT(fmt, ...)

#endif

#define ONCE_INIT_VALUE 0
static atomic_t once_value = ATOMIC_INIT(0);
static const atomic_val_t once_init_value = ONCE_INIT_VALUE;
static pthread_once_t once_control2 = PTHREAD_ONCE_INIT;

static void InitFunc(void)
{
	atomic_val_t o = atomic_get(&once_value);
	(void)o;
	dbg_PRINT("XXXX %ld -> %ld ...\n", o, o + 1);

	/* trigger race condition in pthread_once if not waiting for init-func completion. */
	k_yield();

	atomic_inc(&once_value);
	dbg_PRINT("XXXX %ld -> %ld done\n", o, o + 1);
}

ZTEST(pthread_once, test_0_single)
{
	pthread_setname_np(pthread_self(), "thread_M");
	atomic_set(&once_value, 0);
	static pthread_once_t once_control = PTHREAD_ONCE_INIT;

	/* 1st call */
	zassert_ok(pthread_once(&once_control, &InitFunc));
	zassert_equal(once_init_value + 1, atomic_get(&once_value));

	/* 2nd call */
	zassert_ok(pthread_once(&once_control, &InitFunc));
	zassert_equal(once_init_value + 1, atomic_get(&once_value));
}

ZTEST(pthread_once, test_1_badvalue)
{
	pthread_setname_np(pthread_self(), "thread_M");
	atomic_set(&once_value, 0);
	static pthread_once_t once_control = {99}; /* bad value */

	zassert_equal(EINVAL, pthread_once(&once_control, &InitFunc));
}

#define MY_MIN(a, b)    ((a) < (b) ? (a) : (b))
#define MY_THREAD_COUNT (MY_MIN(CONFIG_POSIX_THREAD_THREADS_MAX, CONFIG_MAX_PTHREAD_COND_COUNT) - 2)
static pthread_mutex_t m_tstart = PTHREAD_MUTEX_INITIALIZER;
static pthread_cond_t cv_tstart;
static pthread_cond_t cv_run[MY_THREAD_COUNT];

static void *AThread(void *arg)
{
	int *id_temp = (int *)arg;
	const int id = *id_temp;

	/* save handling of arg lifecycle */
	zassert_ok(pthread_mutex_lock(&m_tstart));
	{
		char name[20];

		snprintf(name, 20, "thread_%02d", id);
		pthread_setname_np(pthread_self(), name);
	}
	zassert_ok(pthread_cond_signal(&cv_tstart));

	/* post thread creation test launch */
	zassert_ok(pthread_cond_wait(&cv_run[id], &m_tstart));
	zassert_ok(pthread_mutex_unlock(&m_tstart) /* NOSONAR */);
	dbg_PRINT("begin\n");

	/* warm up scheduler */
	for (int i = 0; i < 4; ++i) {
		k_yield();
	}
	zassert_ok(pthread_once(&once_control2, &InitFunc));
	const atomic_val_t v = atomic_get(&once_value);

	zassert_equal(once_init_value + 1, v);

	dbg_PRINT("end\n");
	return NULL;
}

ZTEST(pthread_once, test_2_parallel)
{
	pthread_t threads[MY_THREAD_COUNT];

	pthread_setname_np(pthread_self(), "thread_M");
	pthread_cond_init(&cv_tstart, NULL);
	for (int i = 0; i < MY_THREAD_COUNT; ++i) {
		pthread_cond_init(&cv_run[i], NULL);
	}
	atomic_set(&once_value, 0);
	dbg_PRINT("begin\n");

	zassert_ok(pthread_mutex_lock(&m_tstart));
	for (int i = 0; i < MY_THREAD_COUNT; ++i) {
		/* save handling of arg lifecycle */
		zassert_ok(pthread_create(&threads[i], NULL, &AThread, &i));
		zassert_ok(pthread_cond_wait(&cv_tstart, &m_tstart));
	}
	for (int i = 0; i < MY_THREAD_COUNT; ++i) {
		zassert_ok(pthread_cond_signal(&cv_run[i]));
	}
	dbg_PRINT("run\n");
	zassert_ok(pthread_mutex_unlock(&m_tstart) /* NOSONAR */);

	for (int i = 0; i < MY_THREAD_COUNT; ++i) {
		zassert_ok(pthread_join(threads[i], NULL));
	}
	pthread_cond_destroy(&cv_tstart);
	for (int i = 0; i < MY_THREAD_COUNT; ++i) {
		pthread_cond_destroy(&cv_run[i]);
	}
	const atomic_val_t v = atomic_get(&once_value);

	dbg_PRINT("once_value %ld\n", v);
	zassert_equal(once_init_value + 1, v);
	dbg_PRINT("end\n");
}

static void before(void *arg)
{
	ARG_UNUSED(arg);
	dbg_PRINT("CONFIG_POSIX_THREAD_THREADS_MAX %d\n", CONFIG_POSIX_THREAD_THREADS_MAX);
	dbg_PRINT("CONFIG_MAX_PTHREAD_COND_COUNT %d\n", CONFIG_MAX_PTHREAD_COND_COUNT);
	dbg_PRINT("MY_THREAD_COUNT %d\n", MY_THREAD_COUNT);

	dbg_PRINT("CONFIG_SMP %d\n", IS_ENABLED(CONFIG_SMP));
	dbg_PRINT("CONFIG_MULTITHREADING %d\n", IS_ENABLED(CONFIG_MULTITHREADING));
	dbg_PRINT("CONFIG_TIMESLICE_PER_THREAD %d\n", IS_ENABLED(CONFIG_TIMESLICE_PER_THREAD));
	dbg_PRINT("CONFIG_SYS_CLOCK_TICKS_PER_SEC %d\n", CONFIG_SYS_CLOCK_TICKS_PER_SEC);
	dbg_PRINT("CONFIG_SCHED_DEADLINE %d\n", IS_ENABLED(CONFIG_SCHED_DEADLINE));

	if (!IS_ENABLED(CONFIG_DYNAMIC_THREAD)) {
		/* skip redundant testing if there is no thread pool / heap allocation */
		ztest_test_skip();
	}
}

ZTEST_SUITE(pthread_once, NULL, NULL, before, NULL, NULL);
```

## src/pthread_specific.c
```c
/*
 * Copyright (c) 2026 Göthel Software
 *
 * SPDX-License-Identifier: Apache-2.0 OR MIT
 *
 * If a copy of the Apache-2.0 license was not distributed with this file,
 * You can obtain one at https://www.apache.org/licenses/LICENSE-2.0.
 *
 * If a copy of the MIT license was not distributed with this file,
 * you can obtain one at https://opensource.org/license/mit/.
 */

#ifdef __ZEPHYR__

#include <pthread.h>

#include <zephyr/kernel.h>
#include <zephyr/sys/util.h>
#include <zephyr/ztest.h>

#define STACKSIZE 2000
static K_THREAD_STACK_DEFINE(kthread__stack, STACKSIZE);

/* #define DEBUG_OUTPUT 1 */

#else

#define _GNU_SOURCE
#include <pthread.h>
#include <limits.h>
#include <errno.h>
#include <sched.h>
#include <stdio.h>
#include <stdlib.h>
#include <stdint.h>
#include <string.h>

#define DEBUG_OUTPUT 1

#endif

#ifdef DEBUG_OUTPUT

#define dbg_PRINT(fmt, ...)                                                                        \
	{                                                                                          \
		char name[20];                                                                     \
                                                                                                   \
		pthread_getname_np(pthread_self(), name, sizeof(name));                            \
		fputs(name, stderr);                                                               \
		fputs(": ", stderr);                                                               \
		fprintf(stderr, (fmt)__VA_OPT__(,) __VA_ARGS__);                                   \
		fflush(stderr);                                                                    \
	}

#else

#define dbg_PRINT(fmt, ...)

#endif

#ifndef __ZEPHYR__

#define zassert_ok(v)                                                                              \
	{                                                                                          \
		if ((v)) {                                                                         \
			dbg_PRINT("ERROR line:%d: v %zd, %s\n", __LINE__, (ssize_t)(v),            \
				  strerror(v));                                                    \
			exit(0);                                                                   \
		}                                                                                  \
	}
#define zassert_equal(a, b)                                                                        \
	{                                                                                          \
		if ((ssize_t)(a) != (ssize_t)(b)) {                                                \
			dbg_PRINT("ERROR line:%d : %zd != %zd\n", __LINE__, (ssize_t)(a),          \
				  (ssize_t)(b));                                                   \
			exit(0);                                                                   \
		}                                                                                  \
	}
#define zassert_equal_ptr(a, b)                                                                    \
	{                                                                                          \
		if ((a) != (b)) {                                                                  \
			dbg_PRINT("ERROR line:%d : %p != %p\n", __LINE__, (a), (b));               \
			exit(0);                                                                   \
		}                                                                                  \
	}
#define zassert_not_equal(a, b)                                                                    \
	{                                                                                          \
		if ((a) == (b)) {                                                                  \
			dbg_PRINT("ERROR line:%d : %zd != %zd\n", __LINE__, (ssize_t)(a),          \
				  (ssize_t)(b));                                                   \
			exit(0);                                                                   \
		}                                                                                  \
	}
#define zassert_is_null(a)                                                                         \
	{                                                                                          \
		if ((a)) {                                                                         \
			dbg_PRINT("ERROR line:%d: !null %p\n", __LINE__, (a));                     \
			exit(0);                                                                   \
		}                                                                                  \
	}
#define zassert_not_null(a)                                                                        \
	{                                                                                          \
		if (!(a)) {                                                                        \
			dbg_PRINT("ERROR line:%d : null %p\n", __LINE__, (a));                     \
			exit(0);                                                                   \
		}                                                                                  \
	}

#endif

static pthread_key_t key, key2, key3, key4;
static uint8_t const tagP = 0x11U;
static uint8_t const tagK = 0x22U;
static uint8_t const tagM = 0x33U;
static uint8_t const tagP2 = 0x12U;
static uint8_t const tagK2 = 0x23U;
static uint8_t const tagM2 = 0x34U;

static pthread_mutex_t m = PTHREAD_MUTEX_INITIALIZER;
static pthread_cond_t cv = PTHREAD_COND_INITIALIZER;

#define STAGE_ZERO 0

static volatile int test_stage = STAGE_ZERO;

/**
 * Simple round-robin thread traversal
 * using `test_stage` as index.
 *
 *  Main          T1                  T2
 *
 *  0              1                   2
 *  3              4                   5
 *  6              7                   8
 *  9             10                  11
 * 12             13                  14
 * 15
 */

/* thread-entry start-point wait */
static void test_stage_wait(int stage)
{
	dbg_PRINT("stage: wait %d (has %d)\n", stage, test_stage);
	while (test_stage != stage) {
		zassert_ok(pthread_cond_wait(&cv, &m));
	}
	dbg_PRINT("stage: cont %d\n", test_stage);
}

/* regular round-robin, next awaited-stage is +3 (number of threads) */
static void test_stage_incr_wait(int *stage)
{
	dbg_PRINT("stage: incr %d -> %d\n", test_stage, test_stage + 1);
	test_stage = test_stage + 1;
	zassert_ok(pthread_cond_broadcast(&cv));

	*stage = *stage + 3;
	dbg_PRINT("stage: wait %d (has %d)\n", *stage, test_stage);
	while (test_stage != *stage) {
		zassert_ok(pthread_cond_wait(&cv, &m));
	}
	dbg_PRINT("stage: cont %d\n", test_stage);
}

/* tail-out, unlock mutex and terminate, mutex has to be unlocked thereafter */
static void test_stage_incr(void)
{
	dbg_PRINT("stage: incr %d -> %d\n", test_stage, test_stage + 1);
	test_stage = test_stage + 1;
	zassert_ok(pthread_cond_broadcast(&cv));
}

static void *thread_1(void *arg)
{
	pthread_t pself = pthread_self();
	uint8_t *val;
	int stage = 1;

	(void)arg;
	pthread_setname_np(pself, "thread_1");
	zassert_ok(pthread_mutex_lock(&m));
	test_stage_wait(stage);
	zassert_not_equal(0, pself);

	/* key -> tagP */
	val = (uint8_t *)pthread_getspecific(key);
	zassert_is_null(val);
	zassert_ok(pthread_setspecific(key, (void *)&tagP));
	val = (uint8_t *)pthread_getspecific(key);
	zassert_not_null(val);
	zassert_equal_ptr(val, &tagP);
	zassert_equal(*val, tagP);

	/* key2 -> tagP2 */
	val = (uint8_t *)pthread_getspecific(key2);
	zassert_is_null(val);
	zassert_ok(pthread_setspecific(key2, (void *)&tagP2));
	val = (uint8_t *)pthread_getspecific(key2);
	zassert_not_null(val);
	zassert_equal_ptr(val, &tagP2);
	zassert_equal(*val, tagP2);
	/* re-validate key after key2 setup */
	val = (uint8_t *)pthread_getspecific(key);
	zassert_not_null(val);
	zassert_equal_ptr(val, &tagP);
	zassert_equal(*val, tagP);

	test_stage_incr_wait(&stage);

	/* key2 deleted by host */
	zassert_equal(EINVAL, pthread_key_delete(key2));
	val = (uint8_t *)pthread_getspecific(key2);
	dbg_PRINT("p11: val %p\n", val);
	zassert_is_null(val);
	/* re-validate key after key2 deletion */
	val = (uint8_t *)pthread_getspecific(key);
	dbg_PRINT("p12: val %p\n", val);
	zassert_not_null(val);
	zassert_equal_ptr(val, &tagP);
	zassert_equal(*val, tagP);

	test_stage_incr_wait(&stage);

	/* delete key, check NULL value */
	zassert_ok(pthread_key_delete(key));
	zassert_equal(EINVAL, pthread_key_delete(key));
	val = (uint8_t *)pthread_getspecific(key);
	dbg_PRINT("p13: val %p (key deleted)\n", val);
	zassert_is_null(val);

	test_stage_incr_wait(&stage);

	/* key3 creation, NULL value check and key -> tagP */
	zassert_ok(pthread_key_create(&key3, NULL));
	val = (uint8_t *)pthread_getspecific(key3);
	zassert_is_null(val);
	zassert_ok(pthread_setspecific(key3, (void *)&tagP));
	val = (uint8_t *)pthread_getspecific(key3);
	zassert_not_null(val);
	zassert_equal_ptr(val, &tagP);
	zassert_equal(*val, tagP);
	dbg_PRINT("p14: val %p (key3 created)\n", val);

	test_stage_incr_wait(&stage);

	/* key3 and key4 deleted by host */
	zassert_equal(EINVAL, pthread_key_delete(key3));
	val = (uint8_t *)pthread_getspecific(key3);
	dbg_PRINT("p20: val %p\n", val);
	zassert_is_null(val);

	zassert_equal(EINVAL, pthread_key_delete(key4));
	val = (uint8_t *)pthread_getspecific(key4);
	dbg_PRINT("p21: val %p\n", val);
	zassert_is_null(val);

	dbg_PRINT("pxx: DONE\n");
	test_stage_incr();
	zassert_ok(pthread_mutex_unlock(&m) /* NOSONAR */);
	return NULL;
}

#ifdef __ZEPHYR__
static void thread_2(void)
#else
static void *thread_2(void *arg)
#endif
{
	pthread_t pself = pthread_self();
	uint8_t *val;

#ifndef __ZEPHYR__
	(void)arg;
#endif
	int stage = 2;

	pthread_setname_np(pself, "thread_2");
	zassert_ok(pthread_mutex_lock(&m));
	test_stage_wait(stage);
	dbg_PRINT("stage thread_2 %p\n", (void *)pself);
	zassert_not_equal(0, pself);

	/* key -> tagK */
	val = (uint8_t *)pthread_getspecific(key);
	zassert_is_null(val);
	zassert_ok(pthread_setspecific(key, (void *)&tagK));
	val = (uint8_t *)pthread_getspecific(key);
	zassert_not_null(val);
	zassert_equal_ptr(val, &tagK);
	zassert_equal(*val, tagK);

	/* key2 -> tagK2 */
	val = (uint8_t *)pthread_getspecific(key2);
	zassert_is_null(val);
	zassert_ok(pthread_setspecific(key2, (void *)&tagK2));
	val = (uint8_t *)pthread_getspecific(key2);
	zassert_not_null(val);
	zassert_equal_ptr(val, &tagK2);
	zassert_equal(*val, tagK2);
	/* re-validate key after key2 setup */
	val = (uint8_t *)pthread_getspecific(key);
	zassert_not_null(val);
	zassert_equal_ptr(val, &tagK);
	zassert_equal(*val, tagK);

	test_stage_incr_wait(&stage);

	/* key2 deleted by host */
	zassert_equal(EINVAL, pthread_key_delete(key2));
	val = (uint8_t *)pthread_getspecific(key2);
	dbg_PRINT("k11: val %p\n", val);
	zassert_is_null(val);
	/* re-validate key after key2 deletion */
	val = (uint8_t *)pthread_getspecific(key);
	dbg_PRINT("k12: val %p\n", val);
	zassert_not_null(val);
	zassert_equal_ptr(val, &tagK);
	zassert_equal(*val, tagK);

	test_stage_incr_wait(&stage);

	/* key deleted by thread_1 */
	zassert_equal(EINVAL, pthread_key_delete(key));
	val = (uint8_t *)pthread_getspecific(key);
	dbg_PRINT("k13: val %p\n", val);
	zassert_is_null(val);

	/* key4 creation, NULL value check and key -> tagK */
	zassert_ok(pthread_key_create(&key4, NULL));
	val = (uint8_t *)pthread_getspecific(key4);
	zassert_is_null(val);
	zassert_ok(pthread_setspecific(key4, (void *)&tagK));
	val = (uint8_t *)pthread_getspecific(key4);
	zassert_not_null(val);
	zassert_equal_ptr(val, &tagK);
	zassert_equal(*val, tagK);
	dbg_PRINT("k14: val %p (key4 created)\n", val);

	test_stage_incr_wait(&stage);
	dbg_PRINT("k15\n");
	test_stage_incr_wait(&stage);
	dbg_PRINT("k16\n");

	/* key3 and key4 deleted by host */
	zassert_equal(EINVAL, pthread_key_delete(key3));
	val = (uint8_t *)pthread_getspecific(key3);
	dbg_PRINT("k20: val %p\n", val);
	zassert_is_null(val);

	zassert_equal(EINVAL, pthread_key_delete(key4));
	val = (uint8_t *)pthread_getspecific(key4);
	dbg_PRINT("k21: val %p\n", val);
	zassert_is_null(val);

	dbg_PRINT("kxx: DONE\n");
	test_stage_incr();
	zassert_ok(pthread_mutex_unlock(&m) /* NOSONAR */);

#ifndef __ZEPHYR__
	return NULL;
#endif
}

#ifdef __ZEPHYR__
ZTEST(pthread_specific, test_pthread_specific_01)
#else
int main(int argc, char *argv[])
#endif
{
	pthread_t self = pthread_self();
	pthread_t thread1_id;
#ifdef __ZEPHYR__
	struct k_thread thread2_id;
#else
	pthread_t thread2_id;
#endif
	uint8_t *val;
	int stage = 0;

	pthread_setname_np(self, "thread_M");

	dbg_PRINT("stage main %p\n", (void *)self);
	dbg_PRINT("h00: tagM %p, tagM2 %p\n", &tagM, &tagM2);
	dbg_PRINT("h00: tagP %p, tagP2 %p\n", &tagP, &tagP2);
	dbg_PRINT("h00: tagK %p, tagK2 %p\n", &tagK, &tagK2);

	/* key creation, NULL value check and key -> tagM */
	zassert_ok(pthread_key_create(&key, NULL));
	val = (uint8_t *)pthread_getspecific(key);
	zassert_is_null(val);
	zassert_ok(pthread_setspecific(key, (void *)&tagM));
	val = (uint8_t *)pthread_getspecific(key);
	zassert_not_null(val);
	zassert_equal_ptr(val, &tagM);
	zassert_equal(*val, tagM);
	/* delete key, check NULL value, re-create key */
	{
		zassert_ok(pthread_key_delete(key));
		zassert_equal(EINVAL, pthread_key_delete(key));
		val = (uint8_t *)pthread_getspecific(key);
		zassert_is_null(val);
		zassert_ok(pthread_key_create(&key, NULL));
		val = (uint8_t *)pthread_getspecific(key);
		zassert_is_null(val);
		zassert_ok(pthread_setspecific(key, (void *)&tagM));
		val = (uint8_t *)pthread_getspecific(key);
		zassert_not_null(val);
		zassert_equal_ptr(val, &tagM);
		zassert_equal(*val, tagM);
	}

	/* key2 creation, NULL value check and key2 -> tagM2 */
	zassert_ok(pthread_key_create(&key2, NULL));
	val = (uint8_t *)pthread_getspecific(key2);
	zassert_is_null(val);
	zassert_ok(pthread_setspecific(key2, (void *)&tagM2));
	val = (uint8_t *)pthread_getspecific(key2);
	zassert_not_null(val);
	zassert_equal_ptr(val, &tagM2);
	zassert_equal(*val, tagM2);
	/* re-validate key after key2 setup */
	val = (uint8_t *)pthread_getspecific(key);
	zassert_not_null(val);
	zassert_equal_ptr(val, &tagM);
	zassert_equal(*val, tagM);
	dbg_PRINT("h01\n");

	/* Enter multi-threading tests */
	zassert_ok(pthread_mutex_lock(&m));
	{
		zassert_ok(pthread_create(&thread1_id, NULL, &thread_1, NULL));
#ifdef __ZEPHYR__
		k_thread_create(&thread2_id, kthread__stack, STACKSIZE, (k_thread_entry_t)thread_2,
				NULL, NULL, NULL, K_PRIO_COOP(7), 0, K_NO_WAIT);
#else
		zassert_ok(pthread_create(&thread2_id, NULL, &thread_2, NULL));
#endif
		dbg_PRINT("h02\n");
	}
	test_stage_incr_wait(&stage);
	dbg_PRINT("h04\n");
	/* re-validate this thread's key-pairs after child threads STAGE0 + STAGE1 */
	{
		val = (uint8_t *)pthread_getspecific(key);
		dbg_PRINT("h10: val %p\n", val);
		zassert_not_null(val);
		zassert_equal_ptr(val, &tagM);
		zassert_equal(*val, tagM);

		val = (uint8_t *)pthread_getspecific(key2);
		dbg_PRINT("h11: val %p\n", val);
		zassert_not_null(val);
		zassert_equal_ptr(val, &tagM2);
		zassert_equal(*val, tagM2);
	}
	/* delete key2, check NULL value, re-validate key */
	{
		zassert_ok(pthread_key_delete(key2));
		zassert_equal(EINVAL, pthread_key_delete(key2));
		val = (uint8_t *)pthread_getspecific(key2);
		dbg_PRINT("h12: val %p (key2 deleted)\n", val);
		zassert_is_null(val);
		/* re-validate key after key2 deletion */
		val = (uint8_t *)pthread_getspecific(key);
		dbg_PRINT("h13: val %p\n", val);
		zassert_not_null(val);
		zassert_equal_ptr(val, &tagM);
		zassert_equal(*val, tagM);
	}
	test_stage_incr_wait(&stage);
	test_stage_incr_wait(&stage);

	/* key deleted by thread_1 */
	/* Same behavior Zephyr + Linux: zassert_equal(EINVAL, pthread_key_delete(key)); */
	val = (uint8_t *)pthread_getspecific(key);
	dbg_PRINT("h14: val %p\n", val);
	zassert_is_null(val);

	/* re-validate deleted key2 by this thread */
	zassert_equal(EINVAL, pthread_key_delete(key2));
	val = (uint8_t *)pthread_getspecific(key2);
	dbg_PRINT("h15: val %p\n", val);
	zassert_is_null(val);

	/* re-create key and check NULL value, delete again */
	zassert_ok(pthread_key_create(&key, NULL));
	val = (uint8_t *)pthread_getspecific(key);
	dbg_PRINT("h16: val %p\n", val);
	zassert_is_null(val);
	zassert_ok(pthread_key_delete(key));
	zassert_equal(EINVAL, pthread_key_delete(key));

	test_stage_incr_wait(&stage);

	/* check key3 and key4 created by child threads and delete them */
	val = (uint8_t *)pthread_getspecific(key3);
	dbg_PRINT("h20: val %p\n", val);
	zassert_is_null(val);
	val = (uint8_t *)pthread_getspecific(key4);
	dbg_PRINT("h21: val %p\n", val);
	zassert_is_null(val);
	zassert_ok(pthread_key_delete(key3));
	zassert_equal(EINVAL, pthread_key_delete(key3));
	zassert_ok(pthread_key_delete(key4));
	zassert_equal(EINVAL, pthread_key_delete(key4));

	dbg_PRINT("h22\n");
	test_stage_incr();
	dbg_PRINT("h23\n");
	zassert_ok(pthread_mutex_unlock(&m) /* NOSONAR */);
	dbg_PRINT("h24\n");

	zassert_ok(pthread_join(thread1_id, NULL));
#ifdef __ZEPHYR__
	zassert_ok(k_thread_join(&thread2_id, K_FOREVER));
#else
	zassert_ok(pthread_join(thread2_id, NULL));
#endif
	dbg_PRINT("hXX: DONE\n");
}

#ifdef __ZEPHYR__

static void before(void *arg)
{
	ARG_UNUSED(arg);

	if (!IS_ENABLED(CONFIG_DYNAMIC_THREAD)) {
		/* skip redundant testing if there is no thread pool / heap allocation */
		ztest_test_skip();
	}
}

ZTEST_SUITE(pthread_specific, NULL, NULL, before, NULL, NULL);

#endif
```
